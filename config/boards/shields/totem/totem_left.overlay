/*
 * Copyright (c) 2022 The ZMK Contributors
 *
 * SPDX-License-Identifier: MIT
 */

#include "totem.dtsi"

&kscan0 {
    col-gpios =
        <&xiao_d 2 GPIO_ACTIVE_HIGH>,
        <&xiao_d 3 GPIO_ACTIVE_HIGH>,
        <&xiao_d 4 GPIO_ACTIVE_HIGH>,
        <&xiao_d 5 GPIO_ACTIVE_HIGH>,
        <&xiao_d 6 GPIO_ACTIVE_HIGH>;
};

/ {
    encoder: encoder {
        compatible = "alps,ec11";
        label = "ENCODER";
        a-gpios = <&xiao_d 0 (GPIO_ACTIVE_HIGH | GPIO_PULL_UP)>;
        b-gpios = <&xiao_d 1 (GPIO_ACTIVE_HIGH | GPIO_PULL_UP)>;
        steps = <40>;
        status = "okay";
    };

    sensors {
        compatible = "zmk,keymap-sensors";
        sensors = <&encoder>;
        triggers-per-rotation = <20>;
    };
};